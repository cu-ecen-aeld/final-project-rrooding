## base_external/package/ospi/Config.in
```kconfig
config BR2_PACKAGE_OSPI
	bool "ospi"
    depends on BR2_PACKAGE_LIBGPIOD
    depends on BR2_PACKAGE_MOSQUITTO
    depends on BR2_PACKAGE_LIBOPENSSL
    depends on BR2_PACKAGE_I2C_TOOLS
	help
	  Includes Opensprinkler Pi

comment "ospi needs libgpiod"
    depends on !BR2_PACKAGE_LIBGPIOD
comment "ospi needs mosquitto"
    depends on !BR2_PACKAGE_MOSQUITTO
comment "ospi needs i2c-tools"
    depends on !BR2_PACKAGE_I2C_TOOLS
comment "ospi needs openssl"
    depends on !BR2_PACKAGE_LIBOPENSSL
```

## packages/Config.in
```kconfig
menu "External packages"
	source "../packages/package/opensprinkler-pi/Config.in"
endmenu
```

## packages/package/opensprinkler-pi/Config.in
```kconfig
config BR2_PACKAGE_OPENSPRINKLER_PI
    bool "opensprinkler-pi"
    select BR2_PACKAGE_MOSQUITTO
    select BR2_PACKAGE_LIBGPIOD
    select BR2_PACKAGE_I2C_TOOLS
    help
	  OpenSprinkler Unified Firmware for Linux/OSPi (Raspberry Pi).

	  This package fetches the upstream firmware sources and installs the
	  runtime artifacts for OpenSprinkler Pi.

	  Project home: https://www.opensprinkler.com/
	  Sources: https://github.com/OpenSprinkler/OpenSprinkler-Firmware.git
```
